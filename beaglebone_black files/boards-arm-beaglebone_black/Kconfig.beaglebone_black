## beaglebone_black files/boards-arm-beaglebone_black/Kconfig.beaglebone_black
```kconfig
# SPDX-License-Identifier: Apache-2.0
config BOARD_BEAGLEBONE_BLACK
    # Kconfig.soc'taki tanımı seçiyoruz.
    select SOC_AM335X
```

## beaglebone_black files/zephyr-soc-ti-am335x/Kconfig.defconfig
```kconfig
# SPDX-License-Identifier: Apache-2.0

if SOC_SERIES_AM335X

# Varsayılan olarak bir seri portumuz olduğunu belirtelim.
# Bu, sürücülerin doğru seçilmesine yardımcı olur.
config HAS_UART_AM33XX
    default y

endif # SOC_SERIES_AM335X
```

## beaglebone_black files/zephyr-soc-ti-am335x/Kconfig.soc
```kconfig
# SPDX-License-Identifier: Apache-2.0

# Bu SoC serisini tanımla
config SOC_SERIES_AM335X
    bool
    select ARM
    select CPU_CORTEX_A8

# Bu seriye ait olan spesifik SoC'yi tanımla.
# Bu, board.yml'de kullanacağımız isim olacak.
config SOC_AM335X
    bool
    select SOC_SERIES_AM335X
```

## zephyrproject-main/zephyr/boards/arm/beaglebone_black/beaglebone_black_defconfig
```kconfig
# SPDX-License-Identifier: Apache-2.0

# Karta adını veriyoruz
CONFIG_BOARD_BEAGLEBONE_BLACK=y

# SoC'yi doğrudan ve zorla burada tanımlıyoruz!
# Bu, Kconfig'deki select komutlarının başarısız olma ihtimalini ortadan kaldırır.
CONFIG_SOC_SERIES_AM335X=y
CONFIG_SOC_AM335X=y
# CONFIG_SOC="ti/am335x" # Bu satır kafa karıştırıyor olabilir, şimdilik kapatalım.
                       # Sistem, SOC_AM335X=y'den yola çıkarak yolu bulmalı.

# Diğer temel ayarlar
CONFIG_ARM=y
CONFIG_CPU_CORTEX_A8=y
CONFIG_MAIN_STACK_SIZE=1024
CONFIG_SERIAL=y
CONFIG_CONSOLE=y
CONFIG_UART_CONSOLE=y
CONFIG_GPIO=y
CONFIG_XIP=n
```

## zephyrproject-main/zephyr/boards/arm/beaglebone_black/board.yml
```yaml
board:
  name: beaglebone_black
  full_name: BeagleBone Black Rev C1
  vendor: ti
  socs:
    - name: am335x
```

## zephyrproject-main/zephyr/soc/ti/am335x/Kconfig
```kconfig
# SPDX-License-Identifier: Apache-2.0

# Bu, AM335x SoC Ailesini/Serisini sisteme tanıtır.
if SOC_SERIES_AM335X

# Bu klasördeki Kconfig.soc dosyasını oku.
# Bizim alt klasörümüz olmadığı için '*/Kconfig' yerine bunu kullanıyoruz.
rsource "Kconfig.soc"

endif # SOC_SERIES_AM335X
```
