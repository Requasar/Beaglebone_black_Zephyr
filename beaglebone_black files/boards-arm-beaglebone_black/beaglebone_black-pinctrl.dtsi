/*
 * BeagleBone Black için Pinctrl (Pin Muxing) Tanımları
 */

&am33xx_pinmux { // Bu, am335x.dtsi içinden gelen ana pinmux node'udur

    // UART0 pinleri (P9_24 ve P9_26)
    uart0_pins: pinmux_uart0_pins {
        pinctrl-single,pins = <
            // AM33XX_IOPAD(offset, mux_mode | alıcı_aktif | pull_tipi)
            AM33XX_IOPAD(0x980, 0x20) /* uart0_rxd, MUX_MODE 0, INPUT ENABLED */
            AM33XX_IOPAD(0x984, 0x00) /* uart0_txd, MUX_MODE 0, INPUT DISABLED */
        >;
    };

    // USR LED pinleri
    user_leds_pins: pinmux_user_leds_pins {
        pinctrl-single,pins = <
            AM33XX_IOPAD(0x954, 0x07) /* gpmc_a5.gpio1_21, USR0 */
            AM33XX_IOPAD(0x958, 0x07) /* gpmc_a6.gpio1_22, USR1 */
            AM33XX_IOPAD(0x95c, 0x07) /* gpmc_a7.gpio1_23, USR2 */
            AM33XX_IOPAD(0x960, 0x07) /* gpmc_a8.gpio1_24, USR3 */
        >;
    };
    
    // Diğer pinleri buraya ekleyeceğiz...
};
